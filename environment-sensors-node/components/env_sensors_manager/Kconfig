## environment-sensors-node/components/env_sensors_manager/Kconfig
```kconfig
menu "Environment sensors configuration"
    config ENV_SAMPLE_SIZE
    int "Number of previous measurements to keep in the moving avarage calculation (1 = filter OFF)"
    range 1 20
    default 6
endmenu
```

## environment-sensors-node/components/pir/Kconfig
```kconfig
menu "HC-SR501 PIR configuration"
    config PIR_ACTIVATION_TIME
        int "Motion sampling time frame (seconds)"
        range 10 60
        default 30
    
    config PIR_ACTIVATION_RATIO_THRESHOLD
        int "Activation time ratio requested in the sampling time frame (percentual)"
        range 0 100
        default 50
    
    config PIR_TIMEOUT_TIME
        int "Inactivity timeout (seconds)"
        range PIR_ACTIVATION_TIME 1200
        default 600

endmenu
```

## environment-sensors-node/components/pms_manager/Kconfig
```kconfig
menu "PMSX003 configuration"
    config INDOOR_MODE
        bool "Use Indoor Calibration (CF=1)"
        default n
        help
            If selected, reads PM (CF=1, Standard Particle).
            If not selected (default), reads PM (Atmospheric Environment).
            
            Enable this for lab/clean room usage.
            Disable this for normal outdoor/indoor air monitoring.
    
    config PMS_MAX_RETRY
        int "Max number of retries before giving up on a sensor reading"
        range 1 5
        default 3
endmenu
```

## environment-sensors-node/main/Kconfig.projbuild
```kconfig
menu "WiFi Configuration"
    config ESP_WIFI_SSID
        string "WiFi SSID"
        default "myssid"
        help
            SSID (network name) to connect to.

    config ESP_WIFI_PASSWORD
        string "WiFi Password"
        default "mypassword"
        help
            WiFi password (WPA or WPA2) to use.

    config ESP_MAXIMUM_RETRY
        int "Maximum retry"
        default 5
        help
            Set the Maximum retry to avoid station reconnecting to the AP unlimited when the AP is really inexistent.
endmenu

menu "MQTT Configuration"

    config MQTT_BROKER_URI
        string "MQTT broker URI"
        default "mqtt://test.mosquitto.org:8886"
        help
            URI to the MQTT broker.

endmenu

menu "GPIO Mapping"

    config BUZZER_GPIO
        int "Buzzer GPIO number"
        default 3

    config PIR_GPIO
        int "PIR GPIO number"
        default 4
    
    config LED_GPIO
        int "PIR GPIO number"
        default 5
endmenu

menu "SHT3X configuration"
    config SHT3X_ADDR
        hex "I2C address of SHT3x"
        default 0x44
        help
            I2C address of SHT3x, either 0x44 or 0x45. When ADDR pin is
            grounded, choose 0x44. When ADDR pin is pulled up to VDD, choose
            0x45.
endmenu

menu "I2C configuration"
    config I2C_MASTER_SCL
        int "SCL GPIO Number"
        default 5 if IDF_TARGET_ESP8266
        default 6 if IDF_TARGET_ESP32C2 || IDF_TARGET_ESP32C3 || IDF_TARGET_ESP32C5 || IDF_TARGET_ESP32C6 || IDF_TARGET_ESP32C61
        default 19 if IDF_TARGET_ESP32 || IDF_TARGET_ESP32S2 || IDF_TARGET_ESP32S3
        default 4 if IDF_TARGET_ESP32H2
        default 4 if IDF_TARGET_ESP32P4
        help
            GPIO number for I2C Master clock line.

    config I2C_MASTER_SDA
        int "SDA GPIO Number"
        default 4 if IDF_TARGET_ESP8266
        default 5 if IDF_TARGET_ESP32C2 || IDF_TARGET_ESP32C3 || IDF_TARGET_ESP32C5 || IDF_TARGET_ESP32C6 || IDF_TARGET_ESP32C61
        default 18 if IDF_TARGET_ESP32 || IDF_TARGET_ESP32S2 || IDF_TARGET_ESP32S3
        default 3 if IDF_TARGET_ESP32H2
        default 3 if IDF_TARGET_ESP32P4
        help
            GPIO number for I2C Master data line.
endmenu

menu "HC-SR501 PIR configuration"
    config PIR_ACTIVATION_TIME
        int "Motion sampling time frame (seconds)"
        range 10 60
        default 30
    
    config PIR_ACTIVATION_RATIO_THRESHOLD
        int "Activation time ratio requested in the sampling time frame (percentual)"
        range 0 100
        default 50

endmenu

menu "Gas Sensors Configuration (MQ-7 and MQ-135)"
    config ADC_UNIT
        int "ADC Unit (1 o 2)"
        range 1 2
        default 1

    config MQ7_ADC_CHANNEL
        int "MQ-7 ADC Channel"
        range 0 9
        default 8

    config MQ135_ADC_CHANNEL
        int "MQ-135 ADC Channel"
        range 0 9
        default 9
endmenu

menu "PMSX003 configuration"
    config UART_PORT
        int "UART Port (1 o 2)"
        range 1 2
        default 1

    config TX_GPIO
        int "TX GPIO"
        default 11
        help
            Connect RX pin of PMS sensor to this GPIO

    config RX_GPIO
        int "RX GPIO"
        default 12
        help
            Connect TX pin of PMS sensor to this GPIO

    config SET_GPIO
        int "SET GPIO"
        default 13
        help
            Connect SET pin of PMS sensor to this GPIO
    
    config INDOOR_MODE
        bool "Use Indoor Calibration (CF=1)"
        default n
        help
            If selected, reads PM (CF=1, Standard Particle).
            If not selected (default), reads PM (Atmospheric Environment).
            
            Enable this for lab/clean room usage.
            Disable this for normal outdoor/indoor air monitoring.
endmenu
```

## main/Kconfig.projbuild
```kconfig
menu "WiFi Configuration"
    config ESP_WIFI_SSID
        string "WiFi SSID"
        default "myssid"
        help
            SSID (network name) to connect to.

    config ESP_WIFI_PASSWORD
        string "WiFi Password"
        default "mypassword"
        help
            WiFi password (WPA or WPA2) to use.

    config ESP_MAXIMUM_RETRY
        int "Maximum retry"
        default 5
        help
            Set the Maximum retry to avoid station reconnecting to the AP unlimited when the AP is really inexistent.
endmenu

menu "MQTT Configuration"

    config MQTT_BROKER_URI
        string "MQTT broker URI"
        default "mqtt://test.mosquitto.org:8886"
        help
            URI to the MQTT broker.

endmenu

menu "DHT Configuration"
    choice DHT_CHIP_TYPE
        prompt "Select chip type"
        default DHT_TYPE_AM2301

        config DHT_TYPE_DHT11
            bool "DHT11"
        config DHT_TYPE_AM2301
            bool "DHT21/DHT22/AM2301/AM2302/AM2321"
        config DHT_TYPE_SI7021
            bool "Itead Si7021"
    endchoice
endmenu

menu "GPIO Sensors Mapping"
    config DHT_GPIO
        int "DHT GPIO number"
        default 4

    config BUZZER_GPIO
        int "Buzzer GPIO number"
        default 5

    config PIR_GPIO
        int "PIR GPIO number"
        default 5
endmenu

menu "Gas Sensors Configuration (MQ-7 and MQ-135)"
    config ADC_UNIT
        int "ADC Unit (1 o 2)"
        range 1 2
        default 1

    config MQ7_ADC_CHANNEL
        int "MQ-7 ADC Channel"
        range 0 9
        default 8

    config MQ135_ADC_CHANNEL
        int "MQ-135 ADC Channel"
        range 0 9
        default 9
endmenu
```

## vision-node/components/camera_manager/Kconfig
```kconfig
menu "Camera Manager Configuration"
    choice CAMERA_BOARD_MODEL
        prompt "Camera board model"
        default CAMERA_BOARD_ESP32_CAM_AI_THINKER
        help
            Select the development board used by the camera manager so the
            correct camera pin map is compiled in.

        config CAMERA_BOARD_ESP32_CAM_AI_THINKER
            bool "ESP32-CAM AI-Thinker"

        config CAMERA_BOARD_ESP32S3_EYE
            bool "ESP32-S3-EYE"
    endchoice
endmenu
```

## vision-node/components/ota_update/Kconfig
```kconfig
menu "OTA Configuration"

    config OTA_HTTP_SERVER_URL
        string "HTTP server URL"
        default "http://192.168.1.252:8070/vision-node.bin"

endmenu
```

## vision-node/components/sleep_manager/Kconfig
```kconfig
menu "Deep Sleep Configuration"
    config WAKEUP_PIN
        int "Wakeup GPIO"
        default 13
endmenu
```

## vision-node/main/Kconfig.projbuild
```kconfig
menu "WiFi Configuration"
    config ESP_WIFI_SSID
        string "WiFi SSID"
        default "myssid"
        help
            SSID (network name) to connect to.

    config ESP_WIFI_PASSWORD
        string "WiFi Password"
        default "mypassword"
        help
            WiFi password (WPA or WPA2) to use.

    config ESP_MAXIMUM_RETRY
        int "Maximum retry"
        default 5
        help
            Set the Maximum retry to avoid station reconnecting to the AP unlimited when the AP is really inexistent.
endmenu

menu "MQTT Configuration"

    config MQTT_BROKER_URI
        string "MQTT broker URI"
        default "mqtt://test.mosquitto.org:8886"
        help
            URI to the MQTT broker.

endmenu

menu "OTA Configuration"

    config OTA_HTTP_SERVER_URL
        string "HTTP server URL"
        default "http://192.168.1.252:8070/vision-node.bin"

endmenu
```
